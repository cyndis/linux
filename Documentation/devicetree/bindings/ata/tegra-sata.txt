## Documentation/devicetree/bindings/ata/tegra-sata.txt
```
Tegra124 SoC SATA AHCI controller

Required properties :
 - compatible : Should be "nvidia,tegra124-ahci".
 - reg : Defines the following set of registers, in the order listed:
   - AHCI register set (SATA BAR5)
   - SATA register set
 - interrupts : Defines the interrupt used by SATA
 - clocks : Defines the clocks listed in the clock-names property.
 - clock-names : The following clock names must be present:
   - sata
   - sata-oob
   - cml1
   - pll_e
 - resets : Defines the resets listed in the reset-names property
 - reset-names : The following reset names must be present:
   - sata
   - sata-oob
   - sata-cold
 - phys : Defines the phys listed in the phy-names property
 - phy-names : The following phy names must be present:
   - sata-phy : XUSB PADCTL SATA PHY
 - hvdd-supply : Defines the SATA HVDD regulator
 - vddio-supply : Defines the SATA VDDIO regulator
 - avdd-supply : Defines the SATA AVDD regulator

Optional properties:
 - target-supply : Defines a regulator for a power output connector
                   for SATA devices.
```

## Documentation/devicetree/bindings/memory-controllers/nvidia,tegra124-mc.txt
```
NVIDIA Tegra124 Memory Controller device tree bindings
======================================================

Required properties:
- compatible: Should be "nvidia,tegra124-mc"
- reg: Physical base address and length of the controller's registers.
- interrupts: The interrupt outputs from the controller.
- #iommu-cells: Should be 1. The single cell of the IOMMU specifier defines
  the SWGROUP of the master.

This device implements an IOMMU that complies with the generic IOMMU binding.
See ../iommu/iommu.txt for details.
```

## Documentation/devicetree/bindings/memory-controllers/tegra-emc.txt
```
Tegra124 SoC EMC controller

Required properties :
- compatible : "nvidia,tegra124-emc".
- reg : Should contain 1 entry:
  - EMC register set

The node should contain a "timings@i" subnode for each supported RAM type
  (see field RAM_CODE in register PMC_STRAPPING_OPT_A)
Required properties for "timings@i" nodes :
- nvidia,ram-code : Should contain the value of RAM_CODE this timing set
  is used for.

Each "timings@i" node should contain "timing@j" subnodes. One "timing@j"
  node should exist for each supported EMC clock rate.
Required properties for "timing@j" nodes :
- clock-frequency : Should contain the memory clock rate.
- nvidia,parent-clock-frequency : Should contain the rate of the EMC
  clock's parent clock.
- clocks : Must contain an entry for each entry in clock-names.
  See ../clocks/clock-bindings.txt for details.
- clock-names : Must include the following entries:
  - emc-parent : EMC's parent clock.
- The following properties contain EMC timing characterization values:
  - nvidia,emc-zcal-cnt-long
  - nvidia,emc-auto-cal-interval
  - nvidia,emc-ctt-term-ctrl
  - nvidia,emc-cfg
  - nvidia,emc-cfg-2
  - nvidia,emc-sel-dpd-ctrl
  - nvidia,emc-cfg-dig-dll
  - nvidia,emc-bgbias-ctl0
  - nvidia,emc-auto-cal-config
  - nvidia,emc-auto-cal-config2
  - nvidia,emc-auto-cal-config3
  - nvidia,emc-mode-reset
  - nvidia,emc-mode-1
  - nvidia,emc-mode-2
  - nvidia,emc-mode-4
- nvidia,emc-configuration : EMC timing characterization data written to
                             EMC registers.
```
